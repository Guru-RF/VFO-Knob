## companion/main/Kconfig.projbuild
```kconfig
menu "VFO-Knob second chip"

config VFO_COMPANION_RELEASE
    bool "A release (tools/release.sh): the knob keeps it up to date by itself"
    default n
    help
        Set only by the release overlay (tools/release.sh, and the bench's
        test images built the same way), never by hand. The chip says so in
        its INFO frame; the knob replaces a release with a newer one by
        itself, and leaves a development build alone.

endmenu
```

## main/Kconfig.projbuild
```kconfig
menu "VFO-Knob"

config VFO_GPIO_SCAN
    bool "Diagnostic: scan GPIOs for knob activity instead of running the knob"
    default n
    help
      Samples every plausible GPIO and reports transition counts while the knob
      is turned. Use when a pin assignment is in doubt.

config VFO_USB_NET
    bool "USB-C networking (CDC-NCM) as a transport alongside WiFi"
    default n
    help
      The knob appears to the host as a USB network adapter and reaches
      AetherSDR over the cable. Nothing above the IP layer changes, so TCI,
      PTT and audio all work exactly as they do over WiFi -- and it is immune
      to the metal case's effect on 2.4 GHz.

      IMPORTANT: the ESP32-S3's USB-Serial-JTAG and USB-OTG peripherals share
      the same pins, so a build with this enabled HAS NO SERIAL CONSOLE. Build
      with sdkconfig.usbnet, which also turns the console off.

config VFO_USB_NET_DELAY_MS
    int "Delay before USB networking takes the USB pads (ms)"
    depends on VFO_USB_NET
    range 0 30000
    default 6000
    help
      How long to leave the ROM's USB-Serial-JTAG port enumerated before
      installing TinyUSB.

      This is the device's only way back in. Once TinyUSB owns the PHY the
      serial port is gone, GPIO0 is behind a single button inside the case,
      and the other Type-C orientation reaches the board's second chip rather
      than the ESP32-S3 -- so without this window a bad build can only be
      recovered by opening the case.

      The host needs ~300-500 ms just to enumerate before esptool can open the
      port, so anything under a second or so loses the race. Set 0 only if you
      have reliable physical access to the BOOT button.

config VFO_PANEL_SELFTEST
    bool "Run the display self-test loop at boot"
    default n
    help
      Cycles solid colours, a geometry ring and a backlight ramp three times.
      Useful after touching the panel init table.

config VFO_DEV_CREDENTIALS
    bool "Seed NVS with development WiFi/host credentials on first boot"
    default n
    help
      Writes the values below into NVS if NVS is empty. Intended for bench work
      before the on-screen settings UI exists. Keep the real values in
      sdkconfig.defaults.local, which is gitignored -- never commit a PSK.

if VFO_DEV_CREDENTIALS

config VFO_DEV_WIFI_SSID
    string "WiFi SSID"
    default ""

config VFO_DEV_WIFI_PASS
    string "WiFi passphrase"
    default ""

config VFO_DEV_TCI_HOST
    string "AetherSDR host (IP, or a name ending in .local for mDNS)"
    default "aethersdr.local"

config VFO_DEV_TCI_PORT
    int "AetherSDR TCI port"
    default 50001

endif

endmenu
```
